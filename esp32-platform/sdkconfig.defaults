## esp32-platform/sdkconfig.defaults
```kconfig
CONFIG_ETH_DMA_RX_BUFFER_NUM=20
CONFIG_ETH_DMA_TX_BUFFER_NUM=20
CONFIG_ETH_DMA_BUFFER_SIZE=1600
CONFIG_TCPIP_TASK_STACK_SIZE=4096
CONFIG_ETH_RMII_CLK_INPUT=y
CONFIG_ETH_RMII_CLK_IN_GPIO=0
```
